#include "LidarManager.h"
#include <cstring>

const uint8_t LidarManager::_crcTable[256] = {
  0x00,0x4d,0x9a,0xd7,0x79,0x34,0xe3,0xae,0xf2,0xbf,0x68,0x25,0x8b,0xc6,0x11,0x5c,
  0xa9,0xe4,0x33,0x7e,0xd0,0x9d,0x4a,0x07,0x5b,0x16,0xc1,0x8c,0x22,0x6f,0xb8,0xf5,
  0x1f,0x52,0x85,0xc8,0x66,0x2b,0xfc,0xb1,0xed,0xa0,0x77,0x3a,0x94,0xd9,0x0e,0x43,
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  0xf4,0xb9,0x6e,0x23,0x8d,0xc0,0x17,0x5a,0x06,0x4b,0x9c,0xd1,0x7f,0x32,0xe5,0xa8
};

bool LidarManager::begin(HardwareSerial& port, const Config& cfg) {
  _port = &port;
  _cfg = cfg;
  _port->begin(_cfg.baudRate, SERIAL_8N1, _cfg.rxPin, _cfg.txPin);

  if (_cfg.ledPin >= 0) {
    pinMode(_cfg.ledPin, OUTPUT);
    digitalWrite(_cfg.ledPin, LOW);
  }

  clearData();
  return true;
}

void LidarManager::update() { receiveData(); }

LidarManager::ScanData LidarManager::getScanData() const {
  ScanData data;
  memcpy(data.distanceMm, _distanceMm, sizeof(_distanceMm));
  data.packetsReceived = _packetsReceived;
  data.crcErrors = _crcErrors;
  data.dataReady = (_packetsReceived > 0);
  return data;
}

float LidarManager::getCrcErrorRate() const {
  uint32_t total = _packetsReceived + _crcErrors;
  if (total == 0) return 0.0f;
  return (_crcErrors * 100.0f) / (float)total;
}

void LidarManager::clearData() {
  memset(_distanceMm, 0, sizeof(_distanceMm));
  _packetsReceived = 0;
  _crcErrors = 0;
  _rxIndex = 0;
  _inPacket = false;
}

uint8_t LidarManager::calcCRC8(uint8_t* p, uint8_t len) {
  uint8_t crc = 0;
  for (uint16_t i = 0; i < len; i++) {
    crc = _crcTable[(crc ^ *p++) & 0xff];
  }
  return crc;
}

void LidarManager::parsePacket(LidarFrame* frame) {
  uint8_t calcCrc = calcCRC8((uint8_t*)frame, sizeof(LidarFrame) - 1);
  if (calcCrc != frame->crc8) {
    _crcErrors++;
    return;
  }

  _packetsReceived++;

  float startAngle = frame->start_angle / 100.0f;
  float endAngle   = frame->end_angle / 100.0f;
  if (endAngle < startAngle) endAngle += 360.0f;
  float angleStep = (endAngle - startAngle) / (LIDAR_POINT_PER_PACK - 1);

  for (int i = 0; i < LIDAR_POINT_PER_PACK; i++) {
    float angle = startAngle + angleStep * i;
    while (angle >= 360.0f) angle -= 360.0f;
    while (angle < 0.0f) angle += 360.0f;

    // Keep colleague shift exactly:
    int angleIdx = ((int)angle + 90) % 360;

    uint16_t distance = frame->point[i].distance;

    if (distance > 0 && distance < _cfg.maxDistance) {
      if (_distanceMm[angleIdx] == 0) {
        _distanceMm[angleIdx] = distance;
      } else {
        int diff = abs((int)distance - _distanceMm[angleIdx]);
        if (diff > 50) _distanceMm[angleIdx] = (distance * 7 + _distanceMm[angleIdx] * 3) / 10;
        else           _distanceMm[angleIdx] = (distance * 3 + _distanceMm[angleIdx] * 7) / 10;
      }
    } else {
      if (_distanceMm[angleIdx] > 0) {
        _distanceMm[angleIdx] = _distanceMm[angleIdx] * 9 / 10;
        if (_distanceMm[angleIdx] < 200) _distanceMm[angleIdx] = 0;
      }
    }
  }

  if (_cfg.ledPin >= 0 && _packetsReceived % _cfg.streamInterval == 0) {
    digitalWrite(_cfg.ledPin, !digitalRead(_cfg.ledPin));
  }
}

void LidarManager::receiveData() {
  if (!_port) return;

  while (_port->available()) {
    uint8_t byte = _port->read();

    if (!_inPacket) {
      if (byte == LIDAR_HEADER) {
        _rxBuffer[0] = byte;
        _rxIndex = 1;
        _inPacket = true;
      }
    } else {
      _rxBuffer[_rxIndex++] = byte;

      if (_rxIndex >= sizeof(LidarFrame)) {
        if (_rxBuffer[1] == 0x2C) {
          parsePacket((LidarFrame*)_rxBuffer);
        } else {
          _crcErrors++;
        }
        _rxIndex = 0;
        _inPacket = false;
      }
    }
  }
}
